## config/boards/t_ogura/scanner_pocket_v2/board.yml
```yaml
board:
  name: scanner_pocket_v2
  full_name: Scanner Pocket v2 (FDK HY0020 / nRF52832)
  vendor: t_ogura
  socs:
    - name: nrf52832
```
