#include <behaviors.dtsi>
#include <dt-bindings/zmk/keys.h>

/*
 * The Scanner Pocket is not a keyboard. The only kscan key is a parked
 * dummy on P0.28 (see the board devicetree); the lever is handled by the
 * display code as UI navigation.
 */
/ {
    keymap {
        compatible = "zmk,keymap";

        default_layer {
            bindings = <&none>;
        };
    };
};
